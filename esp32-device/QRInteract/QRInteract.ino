#include <Arduino.h>
#include <WiFi.h>
#include <HTTPClient.h>
#include <WiFiClientSecure.h>
#include <ArduinoJson.h>
#include <TFT_eSPI.h>
#include "esp_camera.h"
#include "soc/soc.h"
#include "soc/rtc_cntl_reg.h"
#include "esp_heap_caps.h"
#include "quirc.h"
#include <vector>

// State Machine Definitions
enum State {
  STATE_STANDBY,
  STATE_PREVIEW,
  STATE_FETCHING,
  STATE_WAIT_CONFIRM,
  STATE_CONFIRMING,
  STATE_SUCCESS,
  STATE_ERROR
};

State currentState = STATE_STANDBY;
unsigned long stateTimer = 0;
unsigned long countdownTimer = 0;
int remainingSeconds = 180; // 3-minute timeout for equipment pickup

// Hardware Pin Definitions
#define BUTTON_PIN 1
#define BUZZER_PIN 2

// WiFi Credentials
const char* ssid = "Fish";
const char* password = "0910100885";

// BFF API Endpoints
const char* bffScanUrl = "https://ntust-robot-researchers-equipment-m.vercel.app/api/iot/auth/scan";
const char* bffConfirmUrl = "https://ntust-robot-researchers-equipment-m.vercel.app/api/iot/auth/confirm";
const char* iotBearerToken = "YOUR_IOT_BEARER_TOKEN"; // Replace with actual token

// Display and Camera Global Instances
TFT_eSPI tft = TFT_eSPI();
static struct quirc *q = NULL;

// Camera Pin Config (NodeMCU32S_CAM / AI-Thinker)
#define PWDN_GPIO_NUM     32
#define RESET_GPIO_NUM    -1
#define XCLK_GPIO_NUM      0
#define SIOD_GPIO_NUM     26
#define SIOC_GPIO_NUM     27
#define Y9_GPIO_NUM       35
#define Y8_GPIO_NUM       34
#define Y7_GPIO_NUM       39
#define Y6_GPIO_NUM       36
#define Y5_GPIO_NUM       21
#define Y4_GPIO_NUM       19
#define Y3_GPIO_NUM       18
#define Y2_GPIO_NUM        5
#define VSYNC_GPIO_NUM    25
#define HREF_GPIO_NUM     23
#define PCLK_GPIO_NUM     22

// Camera and Quirc initialization helpers
static bool camera_init();
static bool quirc_init_global();

// Data Structures
struct BorrowedItem {
  String name;
  int qty;
  String code;
  String allocatedIds;
};

String scannedReqId = "";
String applicantName = "";
std::vector<BorrowedItem> borrowedItems;
bool isScanning = false;

// Active Buzzer Control
void playBeep(int count, int durationMs, int delayMs) {
  for (int i = 0; i < count; i++) {
    digitalWrite(BUZZER_PIN, HIGH);
    delay(durationMs);
    digitalWrite(BUZZER_PIN, LOW);
    if (i < count - 1) {
      delay(delayMs);
    }
  }
}

// Render Standby Screen (Pure Black & White)
void drawStandbyScreen() {
  tft.fillScreen(TFT_BLACK);
  tft.setTextColor(TFT_WHITE);
  tft.setTextSize(2);
  tft.drawString("NTUST RRC", 110, 60);
  tft.drawString("SYSTEM TERMINAL", 70, 90);
  
  tft.drawFastHLine(20, 130, 280, TFT_WHITE);
  
  tft.setTextSize(1);
  tft.drawString("Press Button to Start Borrowing", 65, 160);
}

// Render Scanning Screen with static guide frame (Option A)
void drawScanningScreen() {
  tft.fillScreen(TFT_BLACK);
  tft.setTextColor(TFT_WHITE);
  tft.setTextSize(2);
  tft.drawString("SCANNING QR CODE", 65, 80);
  
  tft.setTextSize(1);
  tft.drawString("Please align the QR Code generated by the website", 30, 130);
  tft.drawString("Distance: 15 - 25 cm", 100, 150);
  
  // Static visual guiding reticle for user alignment
  tft.drawRect(85, 45, 150, 150, TFT_WHITE);
}

// Render Fetching Screen
void drawFetchingScreen() {
  tft.fillScreen(TFT_BLACK);
  tft.setTextColor(TFT_WHITE);
  tft.setTextSize(2);
  tft.drawString("FETCHING DETAILS", 65, 100);
  tft.setTextSize(1);
  tft.drawString("Connecting to Cloud BFF...", 85, 140);
}

// Render Transaction Confirming Screen
void drawConfirmingScreen() {
  tft.fillScreen(TFT_BLACK);
  tft.setTextColor(TFT_WHITE);
  tft.setTextSize(2);
  tft.drawString("CONFIRMING BORROW", 50, 100);
  tft.setTextSize(1);
  tft.drawString("Updating Cabinet & Emailing...", 75, 140);
}

// Render Success Screen
void drawSuccessScreen() {
  tft.fillScreen(TFT_BLACK);
  tft.setTextColor(TFT_WHITE);
  tft.setTextSize(3);
  tft.drawString("SUCCESS", 100, 80);
  
  tft.setTextSize(1);
  tft.drawString("Borrow confirmed! Please take your equipment.", 35, 140);
}

// Render Error Screen
void drawErrorScreen(String message) {
  tft.fillScreen(TFT_BLACK);
  tft.setTextColor(TFT_WHITE);
  tft.setTextSize(3);
  tft.drawString("ERROR", 110, 60);
  
  tft.drawFastHLine(20, 110, 280, TFT_WHITE);
  
  tft.setTextSize(1);
  tft.drawString(message, 30, 140);
  tft.drawString("Returning to standby in 3 seconds...", 60, 180);
}

// Render Borrowing Details Card (Pure Black & White)
void drawBorrowDetailsScreen() {
  tft.fillScreen(TFT_BLACK);
  
  // Navigation Bar
  tft.setTextColor(TFT_WHITE);
  tft.setTextSize(1);
  tft.drawString("RRC IOT SYSTEM TERMINAL", 10, 8);
  tft.drawFastHLine(0, 24, 320, TFT_WHITE);
  
  // Applicant details
  tft.setTextSize(2);
  tft.drawString("Applicant: " + applicantName, 10, 35);
  tft.setTextSize(1);
  tft.drawString("ID: " + scannedReqId, 10, 65);
  
  tft.drawFastHLine(10, 85, 300, TFT_WHITE);
  
  // Equipment List
  tft.drawString("EQUIPMENT LIST (APPROVED):", 10, 95);
  int yOffset = 115;
  for (const auto& item : borrowedItems) {
    // Format matches website: [Name] x[Qty] ([Allocated Serial Codes])
    String displayLine = "- " + item.name + " x" + String(item.qty);
    if (item.allocatedIds != "") {
      displayLine += " (" + item.allocatedIds + ")";
    } else {
      displayLine += " (" + item.code + ")";
    }
    
    tft.drawString(displayLine, 15, yOffset);
    yOffset += 20;
    if (yOffset > 200) break; // Avoid display overflow
  }
  
  tft.drawFastHLine(10, 210, 300, TFT_WHITE);
  
  // Timeout Countdown and progress bar
  int barWidth = (remainingSeconds * 300) / 180;
  tft.drawString("Time Remaining: " + String(remainingSeconds) + "s", 15, 215);
  tft.drawRect(10, 225, 300, 8, TFT_WHITE);
  tft.fillRect(10, 225, barWidth, 8, TFT_WHITE);
}

// Parse JSON Payload from BFF
bool parseBffScanResponse(String jsonStr) {
  DynamicJsonDocument doc(4096);
  DeserializationError error = deserializeJson(doc, jsonStr);
  if (error) {
    Serial.println("JSON parse failed");
    return false;
  }
  
  bool success = doc["success"] | false;
  if (!success) {
    return false;
  }
  
  applicantName = doc["data"]["applicantName"].as<String>();
  scannedReqId = doc["data"]["reqId"].as<String>();
  
  JsonArray itemsArr = doc["data"]["itemsDetail"].as<JsonArray>();
  
  borrowedItems.clear();
  for (JsonObject item : itemsArr) {
    BorrowedItem bItem;
    bItem.code = item["code"].as<String>();
    bItem.name = item["name"].as<String>();
    bItem.qty = item["qty"].as<int>();
    bItem.allocatedIds = ""; // allocated serial codes are not provided in the IoT endpoint
    borrowedItems.push_back(bItem);
  }
  return true;
}

// Send HTTPS POST to BFF Scan API
String sendScanRequest(String reqId) {
  if (WiFi.status() != WL_CONNECTED) {
    return "{\"success\":false,\"message\":\"WiFi disconnected\"}";
  }
  
  WiFiClientSecure client;
  client.setInsecure(); // Skip Vercel SSL validation for dev phase
  
  HTTPClient http;
  http.begin(client, bffScanUrl);
  http.setTimeout(30000); // 30 seconds timeout for GAS response
  http.addHeader("Content-Type", "application/json");
  
  String tokenHeader = "Bearer " + String(iotBearerToken);
  http.addHeader("Authorization", tokenHeader.c_str());
  
  DynamicJsonDocument doc(128);
  doc["reqId"] = reqId;
  String requestBody;
  serializeJson(doc, requestBody);
  
  int httpResponseCode = http.POST(requestBody);
  String response = "{\"success\":false,\"message\":\"HTTP error\"}";
  
  if (httpResponseCode > 0) {
    response = http.getString();
  }
  
  http.end();
  return response;
}

// Send HTTPS POST to BFF Confirm API
bool sendConfirmRequest(String reqId) {
  if (WiFi.status() != WL_CONNECTED) {
    return false;
  }
  
  WiFiClientSecure client;
  client.setInsecure();
  
  HTTPClient http;
  http.begin(client, bffConfirmUrl);
  http.setTimeout(30000); // 30 seconds timeout for GAS write transactions
  http.addHeader("Content-Type", "application/json");
  
  String tokenHeader = "Bearer " + String(iotBearerToken);
  http.addHeader("Authorization", tokenHeader.c_str());
  
  DynamicJsonDocument doc(128);
  doc["reqId"] = reqId;
  String requestBody;
  serializeJson(doc, requestBody);
  
  int httpResponseCode = http.POST(requestBody);
  bool success = false;
  
  if (httpResponseCode == 200) {
    String response = http.getString();
    DynamicJsonDocument respDoc(512);
    deserializeJson(respDoc, response);
    success = respDoc["success"] | false;
  }
  
  http.end();
  return success;
}

// ===== Camera init =====
static bool camera_init() {
  camera_config_t config;
  config.ledc_channel = LEDC_CHANNEL_0;
  config.ledc_timer   = LEDC_TIMER_0;
  config.pin_d0       = Y2_GPIO_NUM;
  config.pin_d1       = Y3_GPIO_NUM;
  config.pin_d2       = Y4_GPIO_NUM;
  config.pin_d3       = Y5_GPIO_NUM;
  config.pin_d4       = Y6_GPIO_NUM;
  config.pin_d5       = Y7_GPIO_NUM;
  config.pin_d6       = Y8_GPIO_NUM;
  config.pin_d7       = Y9_GPIO_NUM;
  config.pin_xclk     = XCLK_GPIO_NUM;
  config.pin_pclk     = PCLK_GPIO_NUM;
  config.pin_vsync    = VSYNC_GPIO_NUM;
  config.pin_href     = HREF_GPIO_NUM;
  config.pin_sscb_sda = SIOD_GPIO_NUM;
  config.pin_sscb_scl = SIOC_GPIO_NUM;
  config.pin_pwdn     = PWDN_GPIO_NUM;
  config.pin_reset    = RESET_GPIO_NUM;

  // GRAYSCALE: 1 byte/pixel directly, bypassing all JPEG decoding overhead
  config.xclk_freq_hz = 10000000; // Reduced to 10MHz to avoid EV-VSYNC-OVF (VSYNC overflow)
  config.pixel_format = PIXFORMAT_GRAYSCALE;
  config.jpeg_quality = 10;
  config.fb_count     = 1;
  config.grab_mode    = CAMERA_GRAB_WHEN_EMPTY;

  if (psramFound()) {
    config.frame_size   = FRAMESIZE_QVGA;   // 320x240
    config.fb_location  = CAMERA_FB_IN_PSRAM;
  } else {
    config.frame_size   = FRAMESIZE_QQVGA;  // 160x120
    config.fb_location  = CAMERA_FB_IN_DRAM;
  }

  esp_err_t err = esp_camera_init(&config);
  if (err != ESP_OK) {
    Serial.printf("Camera init failed: 0x%x\n", err);
    return false;
  }

  // OV2640 sensor tuning for QR
  sensor_t *s = esp_camera_sensor_get();
  if (s) {
    s->set_contrast(s, 2);
    s->set_sharpness(s, 2);
    s->set_brightness(s, 0);
    s->set_saturation(s, -2);    // Desaturate for cleaner grayscale
    s->set_exposure_ctrl(s, 1);
    s->set_aec2(s, 1);
    s->set_ae_level(s, 0);
    s->set_whitebal(s, 1);
    s->set_awb_gain(s, 1);
    s->set_gainceiling(s, GAINCEILING_2X);
  }

  return true;
}

// ===== Quirc init =====
static bool quirc_init_global() {
  q = quirc_new();
  if (!q) {
    Serial.println("quirc_new() failed");
    return false;
  }
  int w = psramFound() ? 320 : 160;
  int h = psramFound() ? 240 : 120;
  if (quirc_resize(q, w, h) < 0) {
    Serial.println("quirc_resize() failed");
    quirc_destroy(q);
    q = NULL;
    return false;
  }
  Serial.printf("quirc ready: %dx%d\n", w, h);
  return true;
}

// FreeRTOS Task for QR Decoding on Core 1
void onQrCodeTask(void *pvParameters) {
  Serial.printf("QR scan task started on core %d\n", xPortGetCoreID());
  while (true) {
    if (currentState == STATE_PREVIEW && isScanning) {
      if (!q) { vTaskDelay(pdMS_TO_TICKS(100)); continue; }

      camera_fb_t *fb = esp_camera_fb_get();
      if (!fb) {
        Serial.println("fb_get failed");
        vTaskDelay(pdMS_TO_TICKS(50));
        continue;
      }

      int qw = 0, qh = 0;
      uint8_t *image = quirc_begin(q, &qw, &qh);
      if (!image || qw == 0 || qh == 0) {
        esp_camera_fb_return(fb);
        vTaskDelay(pdMS_TO_TICKS(50));
        continue;
      }

      // GRAYSCALE: Direct memcpy, no conversion needed
      int pixels = qw * qh;
      memcpy(image, fb->buf, pixels);

      // Contrast stretching for better QR edge detection
      uint8_t lo = 255, hi = 0;
      for (int i = 0; i < pixels; i++) {
        if (image[i] < lo) lo = image[i];
        if (image[i] > hi) hi = image[i];
      }
      if (hi > lo + 10) {
        int range = hi - lo;
        for (int i = 0; i < pixels; i++) {
          int v = ((int)(image[i] - lo) * 255) / range;
          image[i] = (uint8_t)(v < 0 ? 0 : (v > 255 ? 255 : v));
        }
      }

      // Return framebuffer right after copy
      esp_camera_fb_return(fb);
      fb = NULL;

      quirc_end(q);

      int count = quirc_count(q);
      if (count > 0) {
        struct quirc_code code;
        struct quirc_data data;

        quirc_extract(q, 0, &code);
        quirc_decode_error_t err = quirc_decode(&code, &data);

        if (err == QUIRC_SUCCESS) {
          scannedReqId = String((const char *)data.payload);
          Serial.println("=== QR Decoded ===");
          Serial.printf("Version : %d\n", data.version);
          Serial.printf("ECC     : %c\n", "MLHQ"[data.ecc_level]);
          Serial.printf("Length  : %d\n", data.payload_len);
          Serial.printf("Payload : %s\n", scannedReqId.c_str());
          Serial.println("==================");

          isScanning = false;
          playBeep(1, 100, 0); // Short beep on success
        }
      }
    }
    vTaskDelay(pdMS_TO_TICKS(100));
  }
}

void setup() {
  WRITE_PERI_REG(RTC_CNTL_BROWN_OUT_REG, 0);  // disable brownout
  Serial.begin(115200);
  Serial.println("Starting Node 3 visual terminal...");
  
  pinMode(BUTTON_PIN, INPUT_PULLUP);
  pinMode(BUZZER_PIN, OUTPUT);
  digitalWrite(BUZZER_PIN, LOW);
  
  // Initialize TFT Display
  tft.init();
  tft.setRotation(1); // Landscape mode
  tft.fillScreen(TFT_BLACK);
  
  // Initialize Camera
  if (!camera_init()) {
    Serial.println("Camera init failed, halt.");
    while (1) delay(1000);
  }
  Serial.println("Camera ready.");

  // Initialize Quirc
  if (!quirc_init_global()) {
    Serial.println("Quirc init failed, halt.");
    while (1) delay(1000);
  }
  
  // Create a dedicated task with a 20KB stack for the QR scanning logic on Core 1
  xTaskCreatePinnedToCore(onQrCodeTask, "onQrCodeTask", 20000, NULL, 4, NULL, 1);
  
  // WiFi Connection Setup
  tft.setTextColor(TFT_WHITE);
  tft.setTextSize(1);
  tft.drawString("Connecting to WiFi...", 10, 10);
  
  WiFi.begin(ssid, password);
  while (WiFi.status() != WL_CONNECTED) {
    delay(500);
    Serial.print(".");
  }
  Serial.println("\nWiFi connected.");
  tft.drawString("WiFi Connected!", 10, 30);
  
  delay(1000);
  drawStandbyScreen();
  currentState = STATE_STANDBY;
}

void loop() {
  // Simple button debounce
  bool buttonPressed = (digitalRead(BUTTON_PIN) == LOW);
  if (buttonPressed) {
    delay(50);
    buttonPressed = (digitalRead(BUTTON_PIN) == LOW);
  }
  
  switch (currentState) {
    case STATE_STANDBY:
      if (buttonPressed) {
        currentState = STATE_PREVIEW;
        isScanning = true;
        stateTimer = millis();
        drawScanningScreen();
        playBeep(1, 80, 0);
        delay(300); // Debounce delay
      }
      break;
      
    case STATE_PREVIEW:
      if (!isScanning && scannedReqId != "") {
        currentState = STATE_FETCHING;
        drawFetchingScreen();
      }
      // 15-second scanning timeout
      else if (millis() - stateTimer > 15000) {
        isScanning = false;
        currentState = STATE_STANDBY;
        drawStandbyScreen();
        playBeep(2, 50, 50); // Warning double-beep
      }
      break;
      
    case STATE_FETCHING: {
      String jsonResponse = sendScanRequest(scannedReqId);
      if (parseBffScanResponse(jsonResponse)) {
        currentState = STATE_WAIT_CONFIRM;
        remainingSeconds = 180;
        countdownTimer = millis();
        drawBorrowDetailsScreen();
        playBeep(1, 150, 0);
      } else {
        DynamicJsonDocument errDoc(512);
        deserializeJson(errDoc, jsonResponse);
        String errMsg = errDoc["message"].as<String>();
        if (errMsg == "") errMsg = "Application not found or unauthorized";
        
        currentState = STATE_ERROR;
        drawErrorScreen(errMsg);
        playBeep(1, 1500, 0); // Error continuous beep
        stateTimer = millis();
      }
      break;
    }
      
    case STATE_WAIT_CONFIRM: {
      // Countdown handler (1 second intervals)
      if (millis() - countdownTimer >= 1000) {
        remainingSeconds--;
        countdownTimer = millis();
        drawBorrowDetailsScreen();
      }
      
      // Confirm checkout transaction
      if (buttonPressed) {
        currentState = STATE_CONFIRMING;
        drawConfirmingScreen();
        playBeep(1, 80, 0);
        delay(300);
      }
      // 3-minute pickup timeout
      else if (remainingSeconds <= 0) {
        currentState = STATE_ERROR;
        drawErrorScreen("Pickup Timeout! Cancelled.");
        playBeep(3, 100, 100); // 3 warning short beeps
        stateTimer = millis();
      }
      break;
    }
      
    case STATE_CONFIRMING:
      if (sendConfirmRequest(scannedReqId)) {
        currentState = STATE_SUCCESS;
        drawSuccessScreen();
        playBeep(2, 100, 100);
        stateTimer = millis();
      } else {
        currentState = STATE_ERROR;
        drawErrorScreen("Transaction failed! Check internet.");
        playBeep(1, 1500, 0);
        stateTimer = millis();
      }
      break;
      
    case STATE_SUCCESS:
      if (millis() - stateTimer > 3000) {
        scannedReqId = "";
        currentState = STATE_STANDBY;
        drawStandbyScreen();
      }
      break;
      
    case STATE_ERROR:
      if (millis() - stateTimer > 3000) {
        scannedReqId = "";
        currentState = STATE_STANDBY;
        drawStandbyScreen();
      }
      break;
  }
  
  delay(10);
}
